## config/west.yml
```yaml
manifest:
  remotes:
    - name: chase-hunter
      url-base: https://github.com/chase-hunter
  projects:
    - name: zmk
      remote: chase-hunter
      revision: main
      import: app/west.yml
  self:
    path: config
```
